## boards/inpudiy/PNCATEHO_Welcome/Kconfig.defconfig
```kconfig
# Copyright (c) 2023 The ZMK Contributors
# SPDX-License-Identifier: MIT

if BOARD_PNCATEHO_Welcome

config ZMK_KEYBOARD_NAME
    default "PNCATEHO_Welcome"

endif # BOARD_PNCATEHO_Welcome
```

## boards/inpudiy/PNCATEHO_Welcome/board.yml
```yaml
board:
  name: PNCATEHO_Welcome
  vendor: inpudiy
  socs:
    - name: rp2040
      variants:
        - name: zmk
```

## boards/inpudiy/PNCATEHO_Welcome_board/Kconfig
```kconfig
# Copyright (c) 2024 Iacopo Moles
# SPDX-License-Identifier: Apache-2.0

config BOARD_PNCATEHO_WELCOME_BOARD
	select RP2_FLASH_W25Q080
```

## boards/inpudiy/PNCATEHO_Welcome_board/Kconfig.defconfig
```kconfig
# Copyright (c) 2024 Iacopo Moles
# SPDX-License-Identifier: Apache-2.0

if BOARD_PNCATEHO_WELCOME_BOARD

if I2C_DW

config I2C_DW_CLOCK_SPEED
	default 125

endif # I2C_DW

endif # BOARD_PNCATEHO_WELCOME_BOARD
```

## boards/inpudiy/PNCATEHO_Welcome_board/board.yml
```yaml
board:
  name: PNCATEHO_Welcome_board
  full_name: PNCATEHO_Welcome_board
  vendor: waveshare
  socs:
  - name: rp2040
```
